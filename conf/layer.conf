## conf/layer.conf
```bitbake
# We have a conf and classes directory, append to BBPATH
BBPATH .= ":${LAYERDIR}"

# We have a recipes directory containing .bb and .bbappend files, add to BBFILES
BBFILES += "${LAYERDIR}/recipes*/*/*.bb \
            ${LAYERDIR}/recipes*/*/*.bbappend"

BBFILE_COLLECTIONS += "cuteradio"
BBFILE_PATTERN_cuteradio := "^${LAYERDIR}/"
BBFILE_PRIORITY_cuteradio = "10"

LAYERSERIES_COMPAT_cuteradio = "thud"
```
